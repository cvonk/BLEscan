## scanner/main/Kconfig
```kconfig
# erase sdkconfig after changing this file, so it gets rebuild
menu "BLEscan"

    config OTA_UPDATE_FIRMWARE_URL
        string "Firmware upgrade url endpoint"
        default "http://coertvonk.com/cvonk/blescan/scanner.bin"
        help
            URL of server which hosts the firmware image. (make sure it matches Kconfig in factory dir)

    config OTA_UPDATE_RECV_TIMEOUT
        int "OTA Update receive Timeout"
        default 5000
        help
            Maximum time for reception [sec]

    config BLESCAN_MQTT_DATA_TOPIC
        string "MQTT broker uri"
        default "blescan/data"
        help
            MQTT data topic for iBeacons received over BLE

    config BLESCAN_MQTT_CTRL_TOPIC
        string "MQTT broker uri"
        default "blescan/ctrl"
        help
            MQTT ctrl topic

    config BLESCAN_HARDCODED_WIFI_CREDENTIALS
        bool "Use hardcoded Wi-Fi credentials"
        default n
        help
            Use a hardcoded Wi-Fi credentials. Defaults to n for BLE provisioning.
            
    config BLESCAN_HARDCODED_WIFI_SSID
        string "WiFi SSID"
        default ""
        depends on BLESCAN_HARDCODED_WIFI_CREDENTIALS
        help
            SSID (network name).

    config BLESCAN_HARDCODED_WIFI_PASSWD
        string "WiFi Password"
        default ""
        depends on BLESCAN_HARDCODED_WIFI_CREDENTIALS
        help
            WiFi password (WPA or WPA2).
        
    config BLESCAN_HARDCODED_MQTT_CREDENTIALS
        bool "Use hardcoded MQTT URL"
        default n
        help
            Use a hardcoded MQTT credentials. Defaults to n for BLE provisioning.
            
    config BLESCAN_HARDCODED_MQTT_URL
        string "Hardcoded MQTT broker url endpoint"
        default "mqtt://mqtt:passwd@host.domain:1883"
        depends on BLESCAN_HARDCODED_MQTT_CREDENTIALS
        help
            Hardcoded MQTT_URL. E.g. mqtt://mqtt:passwd@host.domain:1883.        

endmenu
```

## scanner/main/Kconfig.example
```kconfig
# erase sdkconfig after changing this file, so it gets rebuild
menu "BLE Scan/Adv App"

    config WIFI_CONNECT_SSID
        string "WiFi SSID"
        default ""
        help
            SSID (network name). Leave empty for BLE provisioning.

    config WIFI_CONNECT_PASSWD
        string "WiFi Password"
        default ""
        help
            WiFi password (WPA or WPA2). Leave empty for BLE provisioning.

    config BLESCAN_MQTT_DATA_TOPIC
        string "MQTT broker uri"
        default "blescan/data"
        help
            MQTT topic for iBeacons received over BLE

    config BLESCAN_MQTT_CTRL_TOPIC
        string "MQTT broker uri"
        default "blescan/ctrl"
        help
            MQTT topic for control messages

    config BLESCAN_MQTT_URL
        string "MQTT broker uri"
        default "mqtt://username:passwd@mqtt.vonk:1883"
        help
            URL of the MQTT broker.  For authentication include the username
            and password.

    config OTA_UPDATE_FIRMWARE_URL
        string "Firmware upgrade url endpoint"
        default "http://host:port/directory/ota_update_test.bin"
        help
            URL of server which hosts the firmware image.

    config OTA_UPDATE_RECV_TIMEOUT
        int "OTA Update receive Timeout"
        default 5000
        help
            Maximum time for reception [sec]

endmenu
```

## scanner/sdkconfig.defaults
```kconfig
# to propagate changes in this file, delete `sdkconfig`

# factory binary is larger than default size
CONFIG_PARTITION_TABLE_CUSTOM=y
CONFIG_PARTITION_TABLE_CUSTOM_FILENAME="../partitions.csv"
CONFIG_PARTITION_TABLE_FILENAME="../partitions.csv"

# need 4 MByte flash for OTA updates
CONFIG_ESPTOOLPY_FLASHSIZE_4MB=y

# enable BLE
CONFIG_BT_ENABLED=y

# optimize for size (didn't fit in OTA otherwise)
CONFIG_COMPILER_OPTIMIZATION_SIZE=y
```
